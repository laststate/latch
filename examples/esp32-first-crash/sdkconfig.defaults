## examples/esp32-first-crash/sdkconfig.defaults
```kconfig
CONFIG_PARTITION_TABLE_CUSTOM=y
CONFIG_PARTITION_TABLE_CUSTOM_FILENAME="partitions.csv"
CONFIG_ESP_SYSTEM_PANIC_PRINT_REBOOT=y
CONFIG_ESP_SYSTEM_PANIC_REBOOT_DELAY_SECONDS=1
CONFIG_ESP_CONSOLE_UART_BAUDRATE=115200
CONFIG_ESPTOOLPY_FLASHSIZE_4MB=y
```

## hil/esp32_relay/sdkconfig.defaults
```kconfig
CONFIG_ESP_SYSTEM_PANIC_PRINT_REBOOT=y
CONFIG_ESP_SYSTEM_PANIC_REBOOT_DELAY_SECONDS=1
CONFIG_ESP_CONSOLE_UART_DEFAULT=y
CONFIG_ESP_CONSOLE_UART_BAUDRATE=115200
CONFIG_ESPTOOLPY_FLASHSIZE_4MB=y
CONFIG_SPI_FLASH_SUPPORT_BOYA_CHIP=y
```

## zephyr/Kconfig
```kconfig
menuconfig LATCH
	bool "LastState Latch crash evidence runtime"
	default y
	help
	  Build the portable, heap-free Latch runtime into this Zephyr image.

if LATCH

config LATCH_MAX_EVENT_SIZE
	int "Maximum LEP event size"
	default 4096
	range 512 16384

endif
```
